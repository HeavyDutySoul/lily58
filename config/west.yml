## config/west.yml
```yaml
manifest:
  remotes:
    - name: zmkfirmware
      url-base: https://github.com/HeavyDutySoul
  projects:
    - name: zmk
      remote: zmkfirmware
      revision: soft_off_new
      import: app/west.yml
  self:
    path: config
```
